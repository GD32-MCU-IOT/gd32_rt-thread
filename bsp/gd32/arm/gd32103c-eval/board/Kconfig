## bsp/gd32/arm/gd32527I-eval/board/Kconfig
```kconfig
menu "Hardware Drivers Config"

config SOC_SERIES_GD32F5xx
    bool
    select ARCH_ARM_CORTEX_SECURE
    default y

config SOC_GD32527
    bool
    select SOC_SERIES_GD32F5xx
    select RT_USING_COMPONENTS_INIT
    select RT_USING_USER_MAIN
    default y

menu "Onboard Peripheral Drivers"

endmenu

menu "On-chip Peripheral Drivers"

    config BSP_USING_GPIO
        bool "Enable GPIO"
        select RT_USING_PIN
        default y

    menuconfig BSP_USING_UART
        bool "Enable UART"
        default y
        select RT_USING_SERIAL
        if BSP_USING_UART
            config BSP_USING_UART_TX_DMA
                bool
                select RT_SERIAL_USING_DMA

            config BSP_USING_UART_RX_DMA
                bool
                select RT_SERIAL_USING_DMA

            config BSP_USING_UART0
                bool "Enable UART0"
                default y

            config BSP_UART0_RX_USING_DMA
                bool "Enable UART0 RX DMA"
                depends on BSP_USING_UART0
                select BSP_USING_UART_RX_DMA
                default n

            config BSP_UART0_TX_USING_DMA
                bool "Enable UART0 TX DMA"
                depends on BSP_USING_UART0
                select BSP_USING_UART_TX_DMA
                default n

            config BSP_USING_UART1
                bool "Enable UART1"
                default n

            config BSP_UART1_RX_USING_DMA
                bool "Enable UART1 RX DMA"
                depends on BSP_USING_UART1
                select BSP_USING_UART_RX_DMA
                default n

            config BSP_UART1_TX_USING_DMA
                bool "Enable UART1 TX DMA"
                depends on BSP_USING_UART1
                select BSP_USING_UART_TX_DMA
                default n

            config BSP_USING_UART2
                bool "Enable UART2"
                default n

            config BSP_UART2_RX_USING_DMA
                bool "Enable UART2 RX DMA"
                depends on BSP_USING_UART2
                select BSP_USING_UART_RX_DMA
                default n

            config BSP_UART2_TX_USING_DMA
                bool "Enable UART2 TX DMA"
                depends on BSP_USING_UART2
                select BSP_USING_UART_TX_DMA
                default n

            config BSP_USING_UART3
                bool "Enable UART3"
                default n

            config BSP_UART3_RX_USING_DMA
                bool "Enable UART3 RX DMA"
                depends on BSP_USING_UART3
                select BSP_USING_UART_RX_DMA
                default n

            config BSP_UART3_TX_USING_DMA
                bool "Enable UART3 TX DMA"
                depends on BSP_USING_UART3
                select BSP_USING_UART_TX_DMA
                default n

            config BSP_USING_UART4
                bool "Enable UART4"
                default n

            config BSP_UART4_RX_USING_DMA
                bool "Enable UART4 RX DMA"
                depends on BSP_USING_UART4
                select BSP_USING_UART_RX_DMA
                default n

            config BSP_UART4_TX_USING_DMA
                bool "Enable UART4 TX DMA"
                depends on BSP_USING_UART4
                select BSP_USING_UART_TX_DMA
                default n

            config BSP_USING_UART5
                bool "Enable UART5"
                default n

            config BSP_UART5_RX_USING_DMA
                bool "Enable UART5 RX DMA"
                depends on BSP_USING_UART5
                select BSP_USING_UART_RX_DMA
                default n

            config BSP_UART5_TX_USING_DMA
                bool "Enable UART5 TX DMA"
                depends on BSP_USING_UART5
                select BSP_USING_UART_TX_DMA
                default n

            config BSP_USING_UART6
                bool "Enable UART6"
                default n

            config BSP_UART6_RX_USING_DMA
                bool "Enable UART6 RX DMA"
                depends on BSP_USING_UART6
                select BSP_USING_UART_RX_DMA
                default n

            config BSP_UART6_TX_USING_DMA
                bool "Enable UART6 TX DMA"
                depends on BSP_USING_UART6
                select BSP_USING_UART_TX_DMA
                default n

            config BSP_USING_UART7
                bool "Enable UART7"
                default n

            config BSP_UART7_RX_USING_DMA
                bool "Enable UART7 RX DMA"
                depends on BSP_USING_UART7
                select BSP_USING_UART_RX_DMA
                default n

            config BSP_UART7_TX_USING_DMA
                bool "Enable UART7 TX DMA"
                depends on BSP_USING_UART7
                select BSP_USING_UART_TX_DMA
                default n

            config BSP_UART_POLL_TX_TIMEOUT_MS
                int "Polling TX timeout in milliseconds"
                range 100 10000
                default 1000
                help
                    Timeout value for polling TX operations in milliseconds.

            if BSP_USING_UART_TX_DMA
                config BSP_UART_DMA_TX_THRESHOLD
                    int "UART DMA TX minimum transfer length"
                    range 1 256
                    default 8
                    help
                        Transfers smaller than this will use polling mode.
                        DMA mode is used when buffer length is greater than or equal to this value.
            endif
        endif

    menuconfig BSP_USING_SPI
        bool "Enable SPI BUS"
        default n
        select RT_USING_SPI
        if BSP_USING_SPI
            config BSP_USING_SPI_DMA
                bool

            config BSP_SPI_XFER_TIMEOUT
                int "SPI transfer timeout (ms)"
                range 1 60000
                default 1000
                help
                    Maximum wait time for a SPI transfer to complete.
                    Applies to both DMA and polling transfer modes.

            config BSP_USING_SPI0
                bool "Enable SPI0 BUS"
                default n

            config BSP_SPI0_USING_DMA
                bool "Enable SPI0 DMA"
                depends on BSP_USING_SPI0
                select BSP_USING_SPI_DMA
                default n

            config BSP_USING_SPI1
                bool "Enable SPI1 BUS"
                default n

            config BSP_SPI1_USING_DMA
                bool "Enable SPI1 DMA"
                depends on BSP_USING_SPI1
                select BSP_USING_SPI_DMA
                default n

            config BSP_USING_SPI2
                bool "Enable SPI2 BUS"
                default n

            config BSP_SPI2_USING_DMA
                bool "Enable SPI2 DMA"
                depends on BSP_USING_SPI2
                select BSP_USING_SPI_DMA
                default n

            config BSP_USING_SPI3
                bool "Enable SPI3 BUS"
                default n

            config BSP_SPI3_USING_DMA
                bool "Enable SPI3 DMA"
                depends on BSP_USING_SPI3
                select BSP_USING_SPI_DMA
                default n

            config BSP_USING_SPI4
                bool "Enable SPI4 BUS"
                default n

            config BSP_SPI4_USING_DMA
                bool "Enable SPI4 DMA"
                depends on BSP_USING_SPI4
                select BSP_USING_SPI_DMA
                default n

            config BSP_USING_SPI5
                bool "Enable SPI5 BUS"
                default n

            config BSP_SPI5_USING_DMA
                bool "Enable SPI5 DMA"
                depends on BSP_USING_SPI5
                select BSP_USING_SPI_DMA
                default n

            if BSP_USING_SPI_DMA
                config BSP_SPI_DMA_TRANS_MIN_LEN
                    int "SPI DMA minimum transfer length"
                    range 4 65535
                    default 16
                    help
                        Transfers smaller than this will use polling mode.
                        DMA mode is used when buffer length is greater than or equal to this value.
            endif
        endif

    menuconfig BSP_USING_I2C
        bool "Enable I2C BUS"
        default n
        select RT_USING_I2C
        if BSP_USING_I2C
            config BSP_USING_I2C_TX_DMA
                bool

            config BSP_USING_I2C_RX_DMA
                bool

            config BSP_USING_HARD_I2C0
                bool "Enable I2C0 BUS"
                default n

            config BSP_I2C0_TX_USING_DMA
                bool "Enable I2C0 TX DMA"
                depends on BSP_USING_HARD_I2C0
                select BSP_USING_I2C_TX_DMA
                default n

            config BSP_I2C0_RX_USING_DMA
                bool "Enable I2C0 RX DMA"
                depends on BSP_USING_HARD_I2C0
                select BSP_USING_I2C_RX_DMA
                default n

            config BSP_USING_HARD_I2C1
                bool "Enable I2C1 BUS"
                default n

            config BSP_I2C1_TX_USING_DMA
                bool "Enable I2C1 TX DMA"
                depends on BSP_USING_HARD_I2C1
                select BSP_USING_I2C_TX_DMA
                default n

            config BSP_I2C1_RX_USING_DMA
                bool "Enable I2C1 RX DMA"
                depends on BSP_USING_HARD_I2C1
                select BSP_USING_I2C_RX_DMA
                default n

            config BSP_USING_HARD_I2C2
                bool "Enable I2C2 BUS"
                default n

            config BSP_I2C2_TX_USING_DMA
                bool "Enable I2C2 TX DMA"
                depends on BSP_USING_HARD_I2C2
                select BSP_USING_I2C_TX_DMA
                default n

            config BSP_I2C2_RX_USING_DMA
                bool "Enable I2C2 RX DMA"
                depends on BSP_USING_HARD_I2C2
                select BSP_USING_I2C_RX_DMA
                default n

            config BSP_USING_HARD_I2C3
                bool "Enable I2C3 BUS (New I2C)"
                default n
                help
                    I2C3 is a new I2C peripheral that supports both TX and RX DMA

            config BSP_I2C3_TX_USING_DMA
                bool "Enable I2C3 TX DMA"
                depends on BSP_USING_HARD_I2C3
                select BSP_USING_I2C_TX_DMA
                default n

            config BSP_I2C3_RX_USING_DMA
                bool "Enable I2C3 RX DMA"
                depends on BSP_USING_HARD_I2C3
                select BSP_USING_I2C_RX_DMA
                default n

            config BSP_USING_HARD_I2C4
                bool "Enable I2C4 BUS (New I2C)"
                default n
                help
                    I2C4 is a new I2C peripheral that supports both TX and RX DMA

            config BSP_I2C4_TX_USING_DMA
                bool "Enable I2C4 TX DMA"
                depends on BSP_USING_HARD_I2C4
                select BSP_USING_I2C_TX_DMA
                default n

            config BSP_I2C4_RX_USING_DMA
                bool "Enable I2C4 RX DMA"
                depends on BSP_USING_HARD_I2C4
                select BSP_USING_I2C_RX_DMA
                default n

            config BSP_USING_HARD_I2C5
                bool "Enable I2C5 BUS (New I2C)"
                default n
                help
                    I2C5 is a new I2C peripheral that supports both TX and RX DMA

            config BSP_I2C5_TX_USING_DMA
                bool "Enable I2C5 TX DMA"
                depends on BSP_USING_HARD_I2C5
                select BSP_USING_I2C_TX_DMA
                default n

            config BSP_I2C5_RX_USING_DMA
                bool "Enable I2C5 RX DMA"
                depends on BSP_USING_HARD_I2C5
                select BSP_USING_I2C_RX_DMA
                default n

            if BSP_USING_I2C_TX_DMA || BSP_USING_I2C_RX_DMA
                config BSP_I2C_DMA_TRANS_MIN_LEN
                    int "I2C DMA minimum transfer length"
                    range 1 256
                    default 8
                    help
                        Transfers smaller than this will use polling mode.
                        DMA mode is used when buffer length is greater than or equal to this value.

                config BSP_I2C_DMA_TIMEOUT
                    int "I2C DMA transfer timeout (ms)"
                    range 1 60000
                    default 1000
                    help
                        Maximum wait time for an I2C DMA transfer to complete.
                        The driver reports a timeout once this limit is reached.
            endif
        endif

    menuconfig BSP_USING_ADC
        bool "Enable ADC"
        default n
        select RT_USING_ADC
        if BSP_USING_ADC
            config BSP_USING_ADC0
                bool "Enable ADC0"
                default n

            config BSP_USING_ADC1
                bool "Enable ADC1"
                default n

            config BSP_USING_ADC2
                bool "Enable ADC2"
                default n
        endif

    menuconfig BSP_USING_TIM
        bool "Enable timer"
        default n
        select RT_USING_HWTIMER
        if BSP_USING_TIM
            config BSP_USING_TIM10
                bool "Enable TIM10"
                default n

            config BSP_USING_TIM11
                bool "Enable TIM11"
                default n

            config BSP_USING_TIM12
                bool "Enable TIM13"
                default n
        endif

    menuconfig BSP_USING_ONCHIP_RTC
        bool "Enable RTC"
        select RT_USING_RTC
        default n
        if BSP_USING_ONCHIP_RTC
            config BSP_USING_ALARM
                bool "Enable RTC alarm"
                select RT_USING_ALARM
                default n
            if BSP_USING_ALARM
                choice
                    prompt "Select rtc alarm device"
                    default BSP_USING_ALARM0

                    config BSP_USING_ALARM0
                        bool "Enable RTC Alarm0"

                    config BSP_USING_ALARM1
                        bool "Enable RTC Alarm1"
                endchoice
            endif
        endif

    config BSP_USING_WDT
        bool "Enable Watchdog Timer"
        select RT_USING_WDT
        default n

    config BSP_USING_SDIO
        bool "Enable SDIO"
        select RT_USING_SDIO
        select RT_USING_DFS
        default n

    config BSP_USING_USBD
        bool "Enable USB Device"
        select RT_USING_USB_DEVICE
        default n

    menuconfig BSP_USING_USBH
        bool "Enable USB Host"
        select RT_USING_USB_HOST
        default n
        if BSP_USING_USBH
            menuconfig RT_USBH_MSTORAGE
                bool "Enable Udisk Drivers"
                default n
                if RT_USBH_MSTORAGE
                    config UDISK_MOUNTPOINT
                    string "Udisk mount dir"
                    default "/"
                endif
        endif

    config BSP_USING_SDRAM
        bool "Enable SDRAM"
        select RT_USING_SDRAM
        default n

    config BSP_USING_LCD
        bool "Enable LCD (TLI RGB565)"
        default n
        select BSP_USING_SDRAM
        help
            On-board 4.3 inch 480x272 RGB LCD driven by TLI.
            Requires SDRAM for the framebuffer.

    config BSP_USING_TOUCH
        bool "Enable Touch Panel"
        default n
        depends on BSP_USING_LCD
        help
            Resistive touch panel (XPT2046-compatible) via bit-banged SPI.

    config BSP_USING_LVGL
        bool "Enable LVGL"
        default n
        depends on BSP_USING_LCD
        select PKG_USING_LVGL
        help
            LVGL v8.3 GUI library with RT-Thread integration.

    config BSP_USING_LVGL_DEMO
        bool "Enable LVGL demo UI"
        default y
        depends on BSP_USING_LVGL
        help
            Built-in demo: a title label and a touch-counter button.

    menuconfig BSP_USING_CAN
        bool "Enable CAN BUS"
        default n
        select RT_USING_CAN
        select RT_USING_DEVICE_IPC
        select BSP_USING_GD_DBG
        if BSP_USING_CAN
            config BSP_USING_CAN0
                bool "Enable CAN0"
                default n

            if BSP_USING_CAN0
                choice
                    prompt "Select CAN0 TX source"
                    default BSP_CAN0_TX_PH13

                    config BSP_CAN0_TX_PA12
                        bool "GPIOA pin 12"
                    config BSP_CAN0_TX_PB9
                        bool "GPIOB pin 9"
                    config BSP_CAN0_TX_PD1
                        bool "GPIOD pin 1"
                    config BSP_CAN0_TX_PH13
                        bool "GPIOH pin 13"
                endchoice

                choice
                    prompt "Select CAN0 RX source"
                    default BSP_CAN0_RX_PI9

                    config BSP_CAN0_RX_PA11
                        bool "GPIOA pin 11"
                    config BSP_CAN0_RX_PB8
                        bool "GPIOB pin 8"
                    config BSP_CAN0_RX_PD0
                        bool "GPIOD pin 0"
                    config BSP_CAN0_RX_PI9
                        bool "GPIOI pin 9"
                endchoice
            endif

        endif

    source "$(BSP_DIR)/../libraries/gd32_drivers/Kconfig"

endmenu

menu "Board extended module Drivers"

endmenu

endmenu
```
