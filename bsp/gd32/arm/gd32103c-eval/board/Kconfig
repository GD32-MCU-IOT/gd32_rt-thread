## bsp/gd32/arm/gd32f350r-eval/board/Kconfig
```kconfig
menu "Hardware Drivers Config"

config SOC_GD32F3x0
    bool
    select SOC_SERIES_GD32F3x0
    select ARCH_ARM_CORTEX_M4
    select RT_USING_USER_MAIN
    select RT_USING_COMPONENTS_INIT
    default y

menu "Onboard Peripheral Drivers"
    menuconfig BSP_USING_SPI_FLASH
        bool "Enable SPI FLASH "
        select BSP_USING_SPI
        select RT_USING_SFUD
        select RT_SFUD_USING_SFDP
        default n

    if BSP_USING_SPI_FLASH
        choice
            prompt "Select SPI Bus"
            default BSP_SPI_FLASH_ON_SPI1

            config BSP_SPI_FLASH_ON_SPI0
                bool "SPI0"
                select BSP_USING_SPI0

            config BSP_SPI_FLASH_ON_SPI1
                bool "SPI1"
                select BSP_USING_SPI1

        endchoice
    endif

    menuconfig BSP_USING_EEPROM
        bool "Enable I2C EEPROM (AT24C02)"
        select BSP_USING_I2C
        default n

    if BSP_USING_EEPROM
        choice
            prompt "Select I2C Bus"
            default BSP_EEPROM_ON_I2C0

            config BSP_EEPROM_ON_I2C0
                bool "I2C0"
                select BSP_USING_HARD_I2C0

            config BSP_EEPROM_ON_I2C1
                bool "I2C1"
                select BSP_USING_HARD_I2C1

        endchoice
    endif
endmenu

menu "On-chip Peripheral Drivers"
    config BSP_USING_GPIO
        bool "Enable GPIO"
        select RT_USING_PIN
        default y

    menuconfig BSP_USING_UART
        bool "Enable UART"
        default y
        select RT_USING_SERIAL
        if BSP_USING_UART
            config BSP_USING_UART_TX_DMA
                bool
                select RT_SERIAL_USING_DMA

            config BSP_USING_UART_RX_DMA
                bool
                select RT_SERIAL_USING_DMA

            config BSP_USING_UART0
                bool "Enable UART0"
                default y

            config BSP_UART0_RX_USING_DMA
                bool "Enable UART0 RX DMA"
                depends on BSP_USING_UART0
                select BSP_USING_UART_RX_DMA
                default n

            config BSP_UART0_TX_USING_DMA
                bool "Enable UART0 TX DMA"
                depends on BSP_USING_UART0
                select BSP_USING_UART_TX_DMA
                default n

            config BSP_USING_UART1
                bool "Enable UART1"
                default n

            config BSP_UART1_RX_USING_DMA
                bool "Enable UART1 RX DMA"
                depends on BSP_USING_UART1
                select BSP_USING_UART_RX_DMA
                default n

            config BSP_UART1_TX_USING_DMA
                bool "Enable UART1 TX DMA"
                depends on BSP_USING_UART1
                select BSP_USING_UART_TX_DMA
                default n

 
        endif

    menuconfig BSP_USING_SPI
        bool "Enable SPI BUS"
        default n
        select RT_USING_SPI
        if BSP_USING_SPI
            config BSP_USING_SPI_TX_DMA
                bool

            config BSP_USING_SPI_RX_DMA
                bool

            config BSP_USING_SPI0
                bool "Enable SPI0 BUS"
                default n
                
            config BSP_SPI0_TX_USING_DMA
                bool "Enable SPI0 TX DMA"
                depends on BSP_USING_SPI0
                select BSP_USING_SPI_TX_DMA
                default n
                
            config BSP_SPI0_RX_USING_DMA
                bool "Enable SPI0 RX DMA"  
                depends on BSP_USING_SPI0
                select BSP_USING_SPI_RX_DMA
                default n

            config BSP_USING_SPI1
                bool "Enable SPI1 BUS"
                default n
                
            config BSP_SPI1_TX_USING_DMA
                bool "Enable SPI1 TX DMA"
                depends on BSP_USING_SPI1
                select BSP_USING_SPI_TX_DMA
                default n
                
            config BSP_SPI1_RX_USING_DMA
                bool "Enable SPI1 RX DMA"
                depends on BSP_USING_SPI1
                select BSP_USING_SPI_RX_DMA
                default n

 
        endif

    menuconfig BSP_USING_I2C
        bool "Enable I2C BUS"
        default n
        select RT_USING_I2C
        if BSP_USING_I2C
            config BSP_USING_I2C_TX_DMA
                bool

            config BSP_USING_I2C_RX_DMA
                bool

            config BSP_USING_HARD_I2C0
                bool "Enable I2C0 BUS"
                default n
            
            config BSP_I2C0_TX_USING_DMA
                bool "Enable I2C0 TX DMA"
                depends on BSP_USING_HARD_I2C0
                select BSP_USING_I2C_TX_DMA
                default n

            config BSP_I2C0_RX_USING_DMA
                bool "Enable I2C0 RX DMA"
                depends on BSP_USING_HARD_I2C0
                select BSP_USING_I2C_RX_DMA
                default n
                
            config BSP_USING_HARD_I2C1
                bool "Enable I2C1 BUS"
                default n
            
            config BSP_I2C1_TX_USING_DMA
                bool "Enable I2C1 TX DMA"
                depends on BSP_USING_HARD_I2C1
                select BSP_USING_I2C_TX_DMA
                default n

            config BSP_I2C1_RX_USING_DMA
                bool "Enable I2C1 RX DMA"
                depends on BSP_USING_HARD_I2C1
                select BSP_USING_I2C_RX_DMA
                default n
                
        endif

    source "$(BSP_DIR)/../libraries/gd32_drivers/Kconfig"
endmenu

menu "Board extended module Drivers"
endmenu

endmenu
```

## bsp/gd32/arm/gd32f503v-eval/Kconfig
```kconfig
mainmenu "RT-Thread Configuration"

config BSP_ROOT
    string
    option env="BSP_ROOT"
    default "."

config RTT_ROOT
    string
    option env="RTT_ROOT"
    default "../../../.."

config PKGS_ROOT
    string
    option env="PKGS_ROOT"
    default "packages"

source "$RTT_ROOT/Kconfig"
source "$PKGS_ROOT/Kconfig"
source "../libraries/Kconfig"
source "board/Kconfig"
```

## bsp/gd32/arm/gd32f5hc-eval/board/Kconfig
```kconfig
menu "Hardware Drivers Config"

config SOC_SERIES_GD32W51x_F5HC
    bool
    select ARCH_ARM_CORTEX_SECURE
    default y

config SOC_GD32F5HC
    bool
    select SOC_SERIES_GD32W51x_F5HC
    select RT_USING_COMPONENTS_INIT
    select RT_USING_USER_MAIN
    default y

menu "Onboard Peripheral Drivers"

endmenu

menu "On-chip Peripheral Drivers"

    config BSP_USING_GPIO
        bool "Enable GPIO"
        select RT_USING_PIN
        default y

    menuconfig BSP_USING_UART
        bool "Enable UART"
        default y
        select RT_USING_SERIAL
        if BSP_USING_UART
            config BSP_USING_UART_TX_DMA
                bool
                select RT_SERIAL_USING_DMA

            config BSP_USING_UART_RX_DMA
                bool
                select RT_SERIAL_USING_DMA

            config BSP_USING_UART0
                bool "Enable UART0"
                default n

            config BSP_UART0_RX_USING_DMA
                bool "Enable UART0 RX DMA"
                depends on BSP_USING_UART0
                select BSP_USING_UART_RX_DMA
                default n

            config BSP_UART0_TX_USING_DMA
                bool "Enable UART0 TX DMA"
                depends on BSP_USING_UART0
                select BSP_USING_UART_TX_DMA
                default n

            config BSP_USING_UART1
                bool "Enable UART1"
                default n

            config BSP_UART1_RX_USING_DMA
                bool "Enable UART1 RX DMA"
                depends on BSP_USING_UART1
                select BSP_USING_UART_RX_DMA
                default n

            config BSP_UART1_TX_USING_DMA
                bool "Enable UART1 TX DMA"
                depends on BSP_USING_UART1
                select BSP_USING_UART_TX_DMA
                default n

            config BSP_USING_UART2
                bool "Enable UART2 (Console)"
                default y

            config BSP_UART2_RX_USING_DMA
                bool "Enable UART2 RX DMA"
                depends on BSP_USING_UART2
                select BSP_USING_UART_RX_DMA
                default n

            config BSP_UART2_TX_USING_DMA
                bool "Enable UART2 TX DMA"
                depends on BSP_USING_UART2
                select BSP_USING_UART_TX_DMA
                default n

            config BSP_UART_POLL_TX_TIMEOUT_MS
                int "Polling TX timeout in milliseconds"
                range 100 10000
                default 1000
                help
                    Timeout value for polling TX operations in milliseconds.

            if BSP_USING_UART_TX_DMA
                config BSP_UART_DMA_TX_THRESHOLD
                    int "UART DMA TX minimum transfer length"
                    range 1 256
                    default 8
                    help
                        Transfers smaller than this will use polling mode.
                        DMA mode is used when buffer length is greater than or equal to this value.
            endif
        endif

    menuconfig BSP_USING_SPI
        bool "Enable SPI BUS"
        default n
        select RT_USING_SPI
        if BSP_USING_SPI
            config BSP_USING_SPI_DMA
                bool

            config BSP_SPI_XFER_TIMEOUT
                int "SPI transfer timeout (ms)"
                range 1 60000
                default 1000
                help
                    Maximum wait time for a SPI transfer to complete.
                    Applies to both DMA and polling transfer modes.

            config BSP_USING_SPI0
                bool "Enable SPI0 BUS"
                default n

            config BSP_SPI0_USING_DMA
                bool "Enable SPI0 DMA"
                depends on BSP_USING_SPI0
                select BSP_USING_SPI_DMA
                default n

            config BSP_USING_SPI1
                bool "Enable SPI1 BUS"
                default n

            config BSP_SPI1_USING_DMA
                bool "Enable SPI1 DMA"
                depends on BSP_USING_SPI1
                select BSP_USING_SPI_DMA
                default n

            if BSP_USING_SPI_DMA
                config BSP_SPI_DMA_TRANS_MIN_LEN
                    int "SPI DMA minimum transfer length"
                    range 4 65535
                    default 16
                    help
                        Transfers smaller than this will use polling mode.
                        DMA mode is used when buffer length is greater than or equal to this value.
            endif
        endif

    menuconfig BSP_USING_I2C
        bool "Enable I2C BUS"
        default n
        select RT_USING_I2C
        if BSP_USING_I2C
            config BSP_USING_I2C_TX_DMA
                bool

            config BSP_USING_I2C_RX_DMA
                bool

            config BSP_USING_HARD_I2C0
                bool "Enable I2C0 BUS"
                default n

            config BSP_I2C0_TX_USING_DMA
                bool "Enable I2C0 TX DMA"
                depends on BSP_USING_HARD_I2C0
                select BSP_USING_I2C_TX_DMA
                default n

            config BSP_I2C0_RX_USING_DMA
                bool "Enable I2C0 RX DMA"
                depends on BSP_USING_HARD_I2C0
                select BSP_USING_I2C_RX_DMA
                default n

            config BSP_USING_HARD_I2C1
                bool "Enable I2C1 BUS"
                default n

            config BSP_I2C1_TX_USING_DMA
                bool "Enable I2C1 TX DMA"
                depends on BSP_USING_HARD_I2C1
                select BSP_USING_I2C_TX_DMA
                default n

            config BSP_I2C1_RX_USING_DMA
                bool "Enable I2C1 RX DMA"
                depends on BSP_USING_HARD_I2C1
                select BSP_USING_I2C_RX_DMA
                default n

            if BSP_USING_I2C_TX_DMA || BSP_USING_I2C_RX_DMA
                config BSP_I2C_DMA_TRANS_MIN_LEN
                    int "I2C DMA minimum transfer length"
                    range 1 256
                    default 8
                    help
                        Transfers smaller than this will use polling mode.
                        DMA mode is used when buffer length is greater than or equal to this value.

                config BSP_I2C_DMA_TIMEOUT
                    int "I2C DMA transfer timeout (ms)"
                    range 1 60000
                    default 1000
                    help
                        Maximum wait time for I2C DMA transfer to complete.
            endif

            menuconfig BSP_USING_SOFT_I2C
                bool "Enable Soft I2C BUS (bit-bang)"
                default n
                select RT_USING_I2C_BITOPS
                select RT_USING_PIN
                if BSP_USING_SOFT_I2C
                    menuconfig BSP_USING_SOFT_I2C0
                        bool "Enable Soft I2C0 BUS (bit-bang)"
                        default n
                        if BSP_USING_SOFT_I2C0
                            config BSP_SOFT_I2C0_SCL_PIN
                                int "Soft I2C0 SCL pin number"
                                default 22
                                help
                                    GPIO pin number for SCL (e.g. PB6 = 22)

                            config BSP_SOFT_I2C0_SDA_PIN
                                int "Soft I2C0 SDA pin number"
                                default 23
                                help
                                    GPIO pin number for SDA (e.g. PB7 = 23)
                        endif

                    menuconfig BSP_USING_SOFT_I2C1
                        bool "Enable Soft I2C1 BUS (bit-bang)"
                        default n
                        if BSP_USING_SOFT_I2C1
                            config BSP_SOFT_I2C1_SCL_PIN
                                int "Soft I2C1 SCL pin number"
                                default 31
                                help
                                    GPIO pin number for SCL (PB15 = 31)

                            config BSP_SOFT_I2C1_SDA_PIN
                                int "Soft I2C1 SDA pin number"
                                default 8
                                help
                                    GPIO pin number for SDA (PA8 = 8)
                        endif
                endif
        endif

    source "$(BSP_DIR)/../libraries/gd32_drivers/Kconfig"

endmenu

menu "Board extended module Drivers"

endmenu

endmenu
```
