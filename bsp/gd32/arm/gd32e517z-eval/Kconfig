## bsp/gd32/arm/gd32e517z-eval/Kconfig
```kconfig
mainmenu "RT-Thread Configuration"

BSP_DIR := .
PKGS_DIR := packages

# Try multiple RT-Thread roots in order (missing paths are ignored)
osource "$(RTT_DIR)/Kconfig"
osource "../rt-thread-master/Kconfig"
osource "../../../../Kconfig"

osource "$PKGS_DIR/Kconfig"

# GD32 common libraries Kconfig from RT-Thread tree (multiple fallbacks)
osource "$(RTT_DIR)/bsp/gd32/arm/libraries/Kconfig"
osource "../rt-thread-master/bsp/gd32/arm/libraries/Kconfig"
osource "../../../../bsp/gd32/arm/libraries/Kconfig"

rsource "board/Kconfig"
```

## bsp/gd32/arm/gd32e517z-eval/board/Kconfig
```kconfig
menu "Hardware Drivers Config"

config SOC_GD32E51X
    bool
    select SOC_SERIES_GD32E51x
    select ARCH_ARM_CORTEX_M33
    select RT_USING_USER_MAIN
    select RT_USING_COMPONENTS_INIT
    default y

menu "Onboard Peripheral Drivers"
    menuconfig BSP_USING_SPI_FLASH
        bool "Enable SPI FLASH (GD25Q16)"
        select BSP_USING_SPI
        select RT_USING_SFUD
        select RT_SFUD_USING_SFDP
        default n

    if BSP_USING_SPI_FLASH
        choice
            prompt "Select SPI Bus"
            default BSP_SPI_FLASH_ON_SPI1

            config BSP_SPI_FLASH_ON_SPI0
                bool "SPI0"
                select BSP_USING_SPI0

            config BSP_SPI_FLASH_ON_SPI1
                bool "SPI1"
                select BSP_USING_SPI1

            config BSP_SPI_FLASH_ON_SPI2
                bool "SPI2"
                select BSP_USING_SPI2
        endchoice
    endif

    menuconfig BSP_USING_EEPROM
        bool "Enable I2C EEPROM (AT24C02)"
        select BSP_USING_I2C
        default n

    if BSP_USING_EEPROM
        choice
            prompt "Select I2C Bus"
            default BSP_EEPROM_ON_I2C0

            config BSP_EEPROM_ON_I2C0
                bool "I2C0"
                select BSP_USING_HARD_I2C0

            config BSP_EEPROM_ON_I2C1
                bool "I2C1"
                select BSP_USING_HARD_I2C1

            config BSP_EEPROM_ON_I2C2
                bool "I2C2"
                select BSP_USING_HARD_I2C2
        endchoice
    endif
endmenu

menu "On-chip Peripheral Drivers"
    config BSP_USING_GPIO
        bool "Enable GPIO"
        select RT_USING_PIN
        default y

    menuconfig BSP_USING_UART
        bool "Enable UART"
        default y
        select RT_USING_SERIAL
        if BSP_USING_UART
            config BSP_USING_UART_TX_DMA
                bool
                select RT_SERIAL_USING_DMA

            config BSP_USING_UART_RX_DMA
                bool
                select RT_SERIAL_USING_DMA

            config BSP_USING_UART0
                bool "Enable UART0"
                default y

            config BSP_UART0_RX_USING_DMA
                bool "Enable UART0 RX DMA"
                depends on BSP_USING_UART0
                select BSP_USING_UART_RX_DMA
                default n

            config BSP_UART0_TX_USING_DMA
                bool "Enable UART0 TX DMA"
                depends on BSP_USING_UART0
                select BSP_USING_UART_TX_DMA
                default n

            config BSP_USING_UART1
                bool "Enable UART1"
                default n

            config BSP_UART1_RX_USING_DMA
                bool "Enable UART1 RX DMA"
                depends on BSP_USING_UART1
                select BSP_USING_UART_RX_DMA
                default n

            config BSP_UART1_TX_USING_DMA
                bool "Enable UART1 TX DMA"
                depends on BSP_USING_UART1
                select BSP_USING_UART_TX_DMA
                default n

            config BSP_USING_UART2
                bool "Enable UART2"
                default n

            config BSP_UART2_RX_USING_DMA
                bool "Enable UART2 RX DMA"
                depends on BSP_USING_UART2
                select BSP_USING_UART_RX_DMA
                default n

            config BSP_UART2_TX_USING_DMA
                bool "Enable UART2 TX DMA"
                depends on BSP_USING_UART2
                select BSP_USING_UART_TX_DMA
                default n

            config BSP_USING_UART3
                bool "Enable UART3"
                default n

            config BSP_UART3_RX_USING_DMA
                bool "Enable UART3 RX DMA"
                depends on BSP_USING_UART3
                select BSP_USING_UART_RX_DMA
                default n

            config BSP_UART3_TX_USING_DMA
                bool "Enable UART3 TX DMA"
                depends on BSP_USING_UART3
                select BSP_USING_UART_TX_DMA
                default n

            config BSP_USING_UART4
                bool "Enable UART4"
                default n

            config BSP_UART4_RX_USING_DMA
                bool "Enable UART4 RX DMA"
                depends on BSP_USING_UART4
                select BSP_USING_UART_RX_DMA
                default n

            config BSP_UART4_TX_USING_DMA
                bool "Enable UART4 TX DMA"
                depends on BSP_USING_UART4
                select BSP_USING_UART_TX_DMA
                default n

            config BSP_USING_UART5
                bool "Enable UART5"
                default n

            config BSP_UART5_RX_USING_DMA
                bool "Enable UART5 RX DMA"
                depends on BSP_USING_UART5
                select BSP_USING_UART_RX_DMA
                default n

            config BSP_UART5_TX_USING_DMA
                bool "Enable UART5 TX DMA"
                depends on BSP_USING_UART5
                select BSP_USING_UART_TX_DMA
                default n
        endif

    menuconfig BSP_USING_SPI
        bool "Enable SPI BUS"
        default n
        select RT_USING_SPI
        if BSP_USING_SPI
            config BSP_USING_SPI_TX_DMA
                bool

            config BSP_USING_SPI_RX_DMA
                bool

            config BSP_USING_SPI0
                bool "Enable SPI0 BUS"
                default n
                
            config BSP_SPI0_TX_USING_DMA
                bool "Enable SPI0 TX DMA"
                depends on BSP_USING_SPI0
                select BSP_USING_SPI_TX_DMA
                default n
                
            config BSP_SPI0_RX_USING_DMA
                bool "Enable SPI0 RX DMA"  
                depends on BSP_USING_SPI0
                select BSP_USING_SPI_RX_DMA
                default n

            config BSP_USING_SPI1
                bool "Enable SPI1 BUS"
                default n
                
            config BSP_SPI1_TX_USING_DMA
                bool "Enable SPI1 TX DMA"
                depends on BSP_USING_SPI1
                select BSP_USING_SPI_TX_DMA
                default n
                
            config BSP_SPI1_RX_USING_DMA
                bool "Enable SPI1 RX DMA"
                depends on BSP_USING_SPI1
                select BSP_USING_SPI_RX_DMA
                default n

            config BSP_USING_SPI2
                bool "Enable SPI2 BUS"
                default n
                
            config BSP_SPI2_TX_USING_DMA
                bool "Enable SPI2 TX DMA"
                depends on BSP_USING_SPI2
                select BSP_USING_SPI_TX_DMA
                default n
                
            config BSP_SPI2_RX_USING_DMA
                bool "Enable SPI2 RX DMA"
                depends on BSP_USING_SPI2
                select BSP_USING_SPI_RX_DMA
                default n
        endif

    menuconfig BSP_USING_I2C
        bool "Enable I2C BUS"
        default n
        select RT_USING_I2C
        if BSP_USING_I2C
            config BSP_USING_I2C_TX_DMA
                bool

            config BSP_USING_I2C_RX_DMA
                bool

            config BSP_USING_HARD_I2C0
                bool "Enable I2C0 BUS"
                default n
            
            config BSP_I2C0_TX_USING_DMA
                bool "Enable I2C0 TX DMA"
                depends on BSP_USING_HARD_I2C0
                select BSP_USING_I2C_TX_DMA
                default n

            config BSP_I2C0_RX_USING_DMA
                bool "Enable I2C0 RX DMA"
                depends on BSP_USING_HARD_I2C0
                select BSP_USING_I2C_RX_DMA
                default n
                
            config BSP_USING_HARD_I2C1
                bool "Enable I2C1 BUS"
                default n
            
            config BSP_I2C1_TX_USING_DMA
                bool "Enable I2C1 TX DMA"
                depends on BSP_USING_HARD_I2C1
                select BSP_USING_I2C_TX_DMA
                default n

            config BSP_I2C1_RX_USING_DMA
                bool "Enable I2C1 RX DMA"
                depends on BSP_USING_HARD_I2C1
                select BSP_USING_I2C_RX_DMA
                default n
                
            config BSP_USING_HARD_I2C2
                bool "Enable I2C2 BUS"
                default n

            config BSP_I2C2_TX_USING_DMA
                bool "Enable I2C2 TX DMA"
                depends on BSP_USING_HARD_I2C2
                select BSP_USING_I2C_TX_DMA
                default n

            config BSP_I2C2_RX_USING_DMA
                bool "Enable I2C2 RX DMA"
                depends on BSP_USING_HARD_I2C2
                select BSP_USING_I2C_RX_DMA
                default n
        endif

    source "$(BSP_DIR)/../libraries/gd32_drivers/Kconfig"
endmenu

menu "Board extended module Drivers"
endmenu

endmenu
```
