## bsp/gd32/arm/gd32470i-eval/board/Kconfig
```kconfig
menu "Hardware Drivers Config"

config SOC_SERIES_GD32F4xx
    bool
    default y

config SOC_GD32470Z
    bool
    select SOC_SERIES_GD32F4xx
    select RT_USING_COMPONENTS_INIT
    select RT_USING_USER_MAIN
    default y

menu "Onboard Peripheral Drivers"

endmenu

menu "On-chip Peripheral Drivers"

    config BSP_USING_GPIO
        bool "Enable GPIO"
        select RT_USING_PIN
        default y

    menuconfig BSP_USING_UART
        bool "Enable UART"
        default y
        select RT_USING_SERIAL
        if BSP_USING_UART
            config BSP_USING_UART0
                bool "Enable UART0"
                default n

            config BSP_UART0_RX_USING_DMA
                bool "Enable UART0 RX DMA"
                depends on BSP_USING_UART0
                select RT_SERIAL_USING_DMA
                default n

            config BSP_UART0_TX_USING_DMA
                bool "Enable UART0 TX DMA"
                depends on BSP_USING_UART0
                select RT_SERIAL_USING_DMA
                default n

            config BSP_UART0_RX_BUFSIZE
                int "Set UART0 RX buffer size"
                range 64 65535
                depends on BSP_USING_UART0 && RT_USING_SERIAL_V2
                default 64

            config BSP_UART0_TX_BUFSIZE
                int "Set UART0 TX buffer size"
                range 0 65535
                depends on BSP_USING_UART0 && RT_USING_SERIAL_V2
                default 0

            config BSP_UART0_DMA_PING_BUFSIZE
                int "Set UART0 RX DMA ping-pong buffer size"
                range 32 65535
                depends on RT_USING_SERIAL_V2 && BSP_UART0_RX_USING_DMA
                default 32
                
            config BSP_USING_UART1
                bool "Enable UART1"
                default y

            config BSP_UART1_RX_USING_DMA
                bool "Enable UART1 RX DMA"
                depends on BSP_USING_UART1
                select RT_SERIAL_USING_DMA
                default n

            config BSP_UART1_TX_USING_DMA
                bool "Enable UART1 TX DMA"
                depends on BSP_USING_UART1
                select RT_SERIAL_USING_DMA
                default n

            config BSP_UART1_RX_BUFSIZE
                int "Set UART1 RX buffer size"
                range 64 65535
                depends on BSP_USING_UART1 && RT_USING_SERIAL_V2
                default 64

            config BSP_UART1_TX_BUFSIZE
                int "Set UART1 TX buffer size"
                range 0 65535
                depends on BSP_USING_UART1 && RT_USING_SERIAL_V2
                default 0

            config BSP_UART1_DMA_PING_BUFSIZE
                int "Set UART1 RX DMA ping-pong buffer size"
                range 32 65535
                depends on RT_USING_SERIAL_V2 && BSP_UART1_RX_USING_DMA
                default 32

            config BSP_USING_UART2
                bool "Enable UART2"
                default n

            config BSP_UART2_RX_USING_DMA
                bool "Enable UART2 RX DMA"
                depends on BSP_USING_UART2
                select RT_SERIAL_USING_DMA
                default n

            config BSP_UART2_TX_USING_DMA
                bool "Enable UART2 TX DMA"
                depends on BSP_USING_UART2
                select RT_SERIAL_USING_DMA
                default n
            
            config BSP_UART2_RX_BUFSIZE
                int "Set UART2 RX buffer size"
                range 64 65535
                depends on BSP_USING_UART2 && RT_USING_SERIAL_V2
                default 64

            config BSP_UART2_TX_BUFSIZE
                int "Set UART2 TX buffer size"
                range 0 65535
                depends on BSP_USING_UART2 && RT_USING_SERIAL_V2
                default 0

            config BSP_UART2_DMA_PING_BUFSIZE
                int "Set UART2 RX DMA ping-pong buffer size"
                range 32 65535
                depends on RT_USING_SERIAL_V2 && BSP_UART2_RX_USING_DMA
                default 32

            config BSP_USING_UART3
                bool "Enable UART3"
                default n

            config BSP_UART3_RX_USING_DMA
                bool "Enable UART3 RX DMA"
                depends on BSP_USING_UART3
                select RT_SERIAL_USING_DMA
                default n

            config BSP_UART3_TX_USING_DMA
                bool "Enable UART3 TX DMA"
                depends on BSP_USING_UART3
                select RT_SERIAL_USING_DMA
                default n

            config BSP_UART3_RX_BUFSIZE
                int "Set UART3 RX buffer size"
                range 64 65535
                depends on BSP_USING_UART3 && RT_USING_SERIAL_V2
                default 64

            config BSP_UART3_TX_BUFSIZE
                int "Set UART3 TX buffer size"
                range 0 65535
                depends on BSP_USING_UART3 && RT_USING_SERIAL_V2
                default 0

            config BSP_UART3_DMA_PING_BUFSIZE
                int "Set UART3 RX DMA ping-pong buffer size"
                range 32 65535
                depends on RT_USING_SERIAL_V2 && BSP_UART3_RX_USING_DMA
                default 32

            config BSP_USING_UART4
                bool "Enable UART4"
                default n

            config BSP_UART4_RX_USING_DMA
                bool "Enable UART4 RX DMA"
                depends on BSP_USING_UART4
                select RT_SERIAL_USING_DMA
                default n

            config BSP_UART4_TX_USING_DMA
                bool "Enable UART4 TX DMA"
                depends on BSP_USING_UART4
                select RT_SERIAL_USING_DMA
                default n

            config BSP_UART4_RX_BUFSIZE
                int "Set UART4 RX buffer size"
                range 64 65535
                depends on BSP_USING_UART4 && RT_USING_SERIAL_V2
                default 64

            config BSP_UART4_TX_BUFSIZE
                int "Set UART4 TX buffer size"
                range 0 65535
                depends on BSP_USING_UART4 && RT_USING_SERIAL_V2
                default 0

            config BSP_UART4_DMA_PING_BUFSIZE
                int "Set UART4 RX DMA ping-pong buffer size"
                range 32 65535
                depends on RT_USING_SERIAL_V2 && BSP_UART4_RX_USING_DMA
                default 32

            config BSP_USING_UART5
                bool "Enable UART5"
                default n

            config BSP_UART5_RX_USING_DMA
                bool "Enable UART5 RX DMA"
                depends on BSP_USING_UART5
                select RT_SERIAL_USING_DMA
                default n

            config BSP_UART5_TX_USING_DMA
                bool "Enable UART5 TX DMA"
                depends on BSP_USING_UART5
                select RT_SERIAL_USING_DMA
                default n

            config BSP_UART5_RX_BUFSIZE
                int "Set UART5 RX buffer size"
                range 64 65535
                depends on BSP_USING_UART5 && RT_USING_SERIAL_V2
                default 64

            config BSP_UART5_TX_BUFSIZE
                int "Set UART5 TX buffer size"
                range 0 65535
                depends on BSP_USING_UART5 && RT_USING_SERIAL_V2
                default 0

            config BSP_UART5_DMA_PING_BUFSIZE
                int "Set UART5 RX DMA ping-pong buffer size"
                range 32 65535
                depends on RT_USING_SERIAL_V2 && BSP_UART5_RX_USING_DMA
                default 32

            config BSP_USING_UART6
                bool "Enable UART6"
                default n

            config BSP_UART6_RX_USING_DMA
                bool "Enable UART6 RX DMA"
                depends on BSP_USING_UART6
                select RT_SERIAL_USING_DMA
                default n

            config BSP_UART6_TX_USING_DMA
                bool "Enable UART6 TX DMA"
                depends on BSP_USING_UART6
                select RT_SERIAL_USING_DMA
                default n

            config BSP_UART6_RX_BUFSIZE
                int "Set UART6 RX buffer size"
                range 64 65535
                depends on BSP_USING_UART6 && RT_USING_SERIAL_V2
                default 64

            config BSP_UART6_TX_BUFSIZE
                int "Set UART6 TX buffer size"
                range 0 65535
                depends on BSP_USING_UART6 && RT_USING_SERIAL_V2
                default 0

            config BSP_UART6_DMA_PING_BUFSIZE
                int "Set UART6 RX DMA ping-pong buffer size"
                range 32 65535
                depends on RT_USING_SERIAL_V2 && BSP_UART6_RX_USING_DMA
                default 32

            config BSP_USING_UART7
                bool "Enable UART7"
                default n

            config BSP_UART7_RX_USING_DMA
                bool "Enable UART7 RX DMA"
                depends on BSP_USING_UART7
                select RT_SERIAL_USING_DMA
                default n

            config BSP_UART7_TX_USING_DMA
                bool "Enable UART7 TX DMA"
                depends on BSP_USING_UART7
                select RT_SERIAL_USING_DMA
                default n

            config BSP_UART7_RX_BUFSIZE
                int "Set UART7 RX buffer size"
                range 64 65535
                depends on BSP_USING_UART7 && RT_USING_SERIAL_V2
                default 64

            config BSP_UART7_TX_BUFSIZE
                int "Set UART7 TX buffer size"
                range 0 65535
                depends on BSP_USING_UART7 && RT_USING_SERIAL_V2
                default 0

            config BSP_UART7_DMA_PING_BUFSIZE
                int "Set UART7 RX DMA ping-pong buffer size"
                range 32 65535
                depends on RT_USING_SERIAL_V2 && BSP_UART7_RX_USING_DMA
                default 32
        endif

    menuconfig BSP_USING_SPI
        bool "Enable SPI BUS"
        default n
        select RT_USING_SPI
        if BSP_USING_SPI
            config BSP_USING_SPI_DMA
                bool

            config BSP_SPI_XFER_TIMEOUT
                int "SPI transfer timeout (ms)"
                range 1 60000
                default 1000
                help
                    Maximum wait time for a SPI transfer to complete.
                    Applies to both DMA and polling transfer modes.

            config BSP_USING_SPI0
                bool "Enable SPI0 BUS"
                default n

            config BSP_SPI0_USING_DMA
                bool "Enable SPI0 DMA"
                depends on BSP_USING_SPI0
                select BSP_USING_SPI_DMA
                default n

            config BSP_USING_SPI1
                bool "Enable SPI1 BUS"
                default n

            config BSP_SPI1_USING_DMA
                bool "Enable SPI1 DMA"
                depends on BSP_USING_SPI1
                select BSP_USING_SPI_DMA
                default n

            config BSP_USING_SPI2
                bool "Enable SPI2 BUS"
                default n

            config BSP_SPI2_USING_DMA
                bool "Enable SPI2 DMA"
                depends on BSP_USING_SPI2
                select BSP_USING_SPI_DMA
                default n

            config BSP_USING_SPI3
                bool "Enable SPI3 BUS"
                default n

            config BSP_SPI3_USING_DMA
                bool "Enable SPI3 DMA"
                depends on BSP_USING_SPI3
                select BSP_USING_SPI_DMA
                default n

            config BSP_USING_SPI4
                bool "Enable SPI4 BUS"
                default n

            config BSP_SPI4_USING_DMA
                bool "Enable SPI4 DMA"
                depends on BSP_USING_SPI4
                select BSP_USING_SPI_DMA
                default n

            config BSP_USING_SPI5
                bool "Enable SPI5 BUS"
                default n

            config BSP_SPI5_USING_DMA
                bool "Enable SPI5 DMA"
                depends on BSP_USING_SPI5
                select BSP_USING_SPI_DMA
                default n

            if BSP_USING_SPI_DMA
                config BSP_SPI_DMA_TRANS_MIN_LEN
                    int "SPI DMA minimum transfer length"
                    range 4 65535
                    default 16
                    help
                        Transfers smaller than this will use polling mode.
                        DMA mode is used when buffer length is greater than or equal to this value.
            endif
        endif

    menuconfig BSP_USING_I2C
        bool "Enable I2C BUS"
        default n
        select RT_USING_I2C
        if BSP_USING_I2C
            config BSP_USING_I2C_TX_DMA
                bool

            config BSP_USING_I2C_RX_DMA
                bool

            config BSP_USING_HARD_I2C0
                bool "Enable I2C0 BUS"
                default n

            config BSP_I2C0_TX_USING_DMA
                bool "Enable I2C0 TX DMA"
                depends on BSP_USING_HARD_I2C0
                select BSP_USING_I2C_TX_DMA
                default n

            config BSP_I2C0_RX_USING_DMA
                bool "Enable I2C0 RX DMA"
                depends on BSP_USING_HARD_I2C0
                select BSP_USING_I2C_RX_DMA
                default n

            config BSP_USING_HARD_I2C1
                bool "Enable I2C1 BUS"
                default n

            config BSP_I2C1_TX_USING_DMA
                bool "Enable I2C1 TX DMA"
                depends on BSP_USING_HARD_I2C1
                select BSP_USING_I2C_TX_DMA
                default n

            config BSP_I2C1_RX_USING_DMA
                bool "Enable I2C1 RX DMA"
                depends on BSP_USING_HARD_I2C1
                select BSP_USING_I2C_RX_DMA
                default n

            config BSP_USING_HARD_I2C2
                bool "Enable I2C2 BUS"
                default n

            config BSP_I2C2_TX_USING_DMA
                bool "Enable I2C2 TX DMA"
                depends on BSP_USING_HARD_I2C2
                select BSP_USING_I2C_TX_DMA
                default n

            config BSP_I2C2_RX_USING_DMA
                bool "Enable I2C2 RX DMA"
                depends on BSP_USING_HARD_I2C2
                select BSP_USING_I2C_RX_DMA
                default n

            if BSP_USING_I2C_TX_DMA || BSP_USING_I2C_RX_DMA
                config BSP_I2C_DMA_TRANS_MIN_LEN
                    int "I2C DMA minimum transfer length"
                    range 1 256
                    default 8
                    help
                        Transfers smaller than this will use polling mode.
                        DMA mode is used when buffer length is greater than or equal to this value.

                config BSP_I2C_DMA_TIMEOUT
                    int "I2C DMA transfer timeout (ms)"
                    range 1 60000
                    default 1000
                    help
                        Maximum wait time for an I2C DMA transfer to complete.
                        The driver reports a timeout once this limit is reached.
            endif

            menuconfig BSP_USING_SOFT_I2C0
                bool "Enable Soft I2C0 BUS (bit-bang)"
                select RT_USING_I2C_BITOPS
                default n
                if BSP_USING_SOFT_I2C0
                    config BSP_SOFT_I2C0_SCL_PIN
                        int "Soft I2C0 SCL pin number"
                        default 22
                        help
                            GPIO pin number for SCL (e.g. PB6 = 22)

                    config BSP_SOFT_I2C0_SDA_PIN
                        int "Soft I2C0 SDA pin number"
                        default 23
                        help
                            GPIO pin number for SDA (e.g. PB7 = 23)
                endif

            menuconfig BSP_USING_SOFT_I2C1
                bool "Enable Soft I2C1 BUS (bit-bang)"
                select RT_USING_I2C_BITOPS
                default n
                if BSP_USING_SOFT_I2C1
                    config BSP_SOFT_I2C1_SCL_PIN
                        int "Soft I2C1 SCL pin number"
                        default 24

                    config BSP_SOFT_I2C1_SDA_PIN
                        int "Soft I2C1 SDA pin number"
                        default 25
                endif
        endif

    menuconfig BSP_USING_ADC
        bool "Enable ADC"
        default n
        select RT_USING_ADC
        if BSP_USING_ADC
            config BSP_USING_ADC0
                bool "Enable ADC0"
                default n

            config BSP_USING_ADC1
                bool "Enable ADC1"
                default n

            config BSP_USING_ADC2
                bool "Enable ADC2"
                default n
        endif

    menuconfig BSP_USING_TIM
        bool "Enable timer"
        default n
        select RT_USING_HWTIMER
        if BSP_USING_TIM
            config BSP_USING_TIM10
                bool "Enable TIM10"
                default n

            config BSP_USING_TIM11
                bool "Enable TIM11"
                default n

            config BSP_USING_TIM12
                bool "Enable TIM13"
                default n
        endif

    menuconfig BSP_USING_ONCHIP_RTC
        bool "Enable RTC"
        select RT_USING_RTC
        default n
        if BSP_USING_ONCHIP_RTC
            config BSP_USING_ALARM
                bool "Enable RTC alarm"
                select RT_USING_ALARM
                default n
            if BSP_USING_ALARM
                choice
                    prompt "Select rtc alarm device"
                    default BSP_USING_ALARM0

                    config BSP_USING_ALARM0
                        bool "Enable RTC Alarm0"

                    config BSP_USING_ALARM1
                        bool "Enable RTC Alarm1"
                endchoice
            endif
        endif

    config BSP_USING_WDT
        bool "Enable Watchdog Timer"
        select RT_USING_WDT
        default n

    config BSP_USING_SDIO
        bool "Enable SDIO"
        select RT_USING_SDIO
        select RT_USING_DFS
        default n

    config BSP_USING_USBD
        bool "Enable USB Device"
        select RT_USING_USB_DEVICE
        default n

    menuconfig BSP_USING_USBH
        bool "Enable USB Host"
        select RT_USING_USB_HOST
        default n
        if BSP_USING_USBH
            menuconfig RT_USBH_MSTORAGE
                bool "Enable Udisk Drivers"
                default n
                if RT_USBH_MSTORAGE
                    config UDISK_MOUNTPOINT
                    string "Udisk mount dir"
                    default "/"
                endif
        endif

    config BSP_USING_SDRAM
        bool "Enable SDRAM"
        select RT_USING_SDRAM
        default n

    source "$(BSP_DIR)/../libraries/gd32_drivers/Kconfig"

endmenu

menu "Board extended module Drivers"

    menuconfig BSP_USING_LCD
        bool "Enable LCD"
        select RT_USING_LCD
        default n
        if BSP_USING_LCD

            config BSP_USING_TLI
                bool "Enable TLI"
                default y  

            config BSP_USING_SDRAM
                bool "Enable SDRAM"
                select RT_USING_SDRAM
                default y

            config BSP_USING_TOUCH
                bool "Enable TOUCH"
                select RT_USING_TOUCH
                default n
                
            config BSP_USING_GPU
                bool "Enable GPU"
                select RT_USING_GPU
                default y

            config BSP_USING_DRAW_PANEL_EXAMPLE
                bool "Enable DRAW PANEL EXAMPLE"
                select RT_USING_DRAW_PANEL_EXAMPLE
                default n
        endif
        
endmenu

endmenu
```
